# STM32L432KCTest register map
Registers are 32-bit, access not given, no defined reset value unless marked. A register's access mark holds for its fields unless they carry their own. Offsets are from the block's base; lines under a group give offsets from that group; [hi:lo] are bit positions; {n}, {i} and the like mark numbered series; 'fields as' and 'values as' point back to an identical list; <NAME> marks a mode.

## Memory map
0x40021000 RCC
0x48000000 GPIOA

## GPIOA
Base 0x48000000
0x00 MODER rw
0x10 IDR ro

## RCC
Base 0x40021000
0x00 CR
0x08 CFGR
